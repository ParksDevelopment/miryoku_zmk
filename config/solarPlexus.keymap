// Copyright 2022 Manna Harbour
// https://github.com/manna-harbour/miryoku

#include "../miryoku/custom_config.h"
#include "../miryoku/mapping/36/solarPlexus.h"
#include "../miryoku/miryoku.dtsi"
#include "tapToggle.dtsi"
